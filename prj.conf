## CMakeLists.txt
```
# SPDX-License-Identifier: Apache-2.0

cmake_minimum_required(VERSION 3.20.0)
find_package(Zephyr REQUIRED HINTS $ENV{ZEPHYR_BASE})

project(zephyrus)

target_sources(app PRIVATE src/main.c)
```

## prj.conf
```kconfig
CONFIG_LOG=y
CONFIG_SHELL=y

CONFIG_DISPLAY=y
CONFIG_INPUT=y

CONFIG_FILE_SYSTEM=y
CONFIG_FAT_FILESYSTEM_ELM=y

CONFIG_LVGL=y
CONFIG_LV_Z_MEM_POOL_SIZE=58368
```

## boards/native_sim_64.conf
```kconfig
CONFIG_FS_FATFS_EXFAT=y

CONFIG_FUSE_FS_ACCESS=y
CONFIG_FUSE_CLIENT_UID_VALUE=1000
CONFIG_FUSE_CLIENT_GID_VALUE=1001
```

## boards/native_sim.overlay
```dts
&sdl_dc {
    height = <800>;
    width = <480>;
};

&storage_partition {
	reg = <0x000fc000 DT_SIZE_M(1)>;
};

/ {
	disk0 {
		status = "okay";
		compatible = "zephyr,flash-disk";
		partition = <&storage_partition>;
		disk-name = "SD";
		cache-size = <4096>;
	};
};
```

## src/main.c
```c
#define LOG_LEVEL CONFIG_LOG_DEFAULT_LEVEL
#include <zephyr/logging/log.h>
LOG_MODULE_REGISTER(app);

#include <zephyr/kernel.h>
#include <zephyr/drivers/display.h>

#include <zephyr/fs/fs.h>
#include <ff.h>

#include <lvgl.h>

static FATFS fat_fs;
static struct fs_mount_t fs = {
	.type = FS_FATFS,
	.fs_data = &fat_fs,
	.mnt_point = "/SD:",
	.storage_dev = "SD",
};

static void button_clicked_cb(lv_event_t *event)
{
	LOG_INF("Button event: %s", lv_event_code_get_name(lv_event_get_code(event)));
}

static void write_file()
{
	int ret;

	ret = fs_mount(&fs);
	if (ret < 0)
	{
		printk("Mount failed: %d\n", ret);
	}

	struct fs_file_t file;
	fs_file_t_init(&file);

	ret = fs_open(&file, "/SD:/hello.txt", FS_O_CREATE | FS_O_WRITE);
	if (ret < 0)
	{
		printk("Open failed: %d\n", ret);
	}

	const char *data = "Hello Zephyr!";
	ret = fs_write(&file, data, strlen(data));
	if (ret < 0)
	{
		printk("Write failed: %d\n", ret);
	}
	fs_close(&file);
}

int main(void)
{
	const struct device *display_dev;
	lv_obj_t *label;
	lv_obj_t *button;
	int ret;

	display_dev = DEVICE_DT_GET(DT_CHOSEN(zephyr_display));
	if (!device_is_ready(display_dev))
	{
		LOG_ERR("Device not ready");
		return 0;
	}

	write_file();

	button = lv_button_create(lv_screen_active());
	lv_obj_add_event_cb(button, button_clicked_cb, LV_EVENT_CLICKED, NULL);
	lv_obj_center(button);

	label = lv_label_create(button);
	lv_label_set_text(label, "Hello world!");

	lv_timer_handler();
	ret = display_blanking_off(display_dev);
	if (ret < 0 && ret != -ENOSYS)
	{
		LOG_ERR("Failed to turn blanking off (error %d)", ret);
		return 0;
	}

	while (1)
	{
		lv_timer_handler();
		k_msleep(5);
	}

	return 0;
}
```
